#include <WiFi.h>
#include <WebServer.h>
#include <Adafruit_GFX.h>
#include <Adafruit_SSD1306.h>
#include <pgmspace.h>

#define SCREEN_WIDTH 128
#define SCREEN_HEIGHT 64
Adafruit_SSD1306 display(SCREEN_WIDTH, SCREEN_HEIGHT, &Wire, -1);

const char* ssid = "No one likes you";
const char* pass = "sixthform";

WebServer server(80);


String mood = "neutral";

int happiness = 100;
int energy = 100;
int current_frame = 0;
int age = 0;
int hunger = 20;

static const int SPRITE_H = 39;
static const int SPRITE_W = 33;

using SpriteRow = uint8_t[SPRITE_W];


void drawScreen();

void handleArgs() {
  if (server.hasArg("happiness")) happiness = server.arg("happiness").toInt();
  if (server.hasArg("energy")) energy = server.arg("energy").toInt();
  if (server.hasArg("current_frame")) current_frame = server.arg("current_frame").toInt();
  if (server.hasArg("age")) age = server.arg("age").toInt();
  if (server.hasArg("hunger")) hunger = server.arg("hunger").toInt();

  drawScreen();
  server.send(200, "text/plain", "updated");
}

void drawScreen() {
   display.clearDisplay();
  display.setTextSize(1);
  display.setTextColor(SSD1306_WHITE);
  // top status line
  display.setCursor(0, 0);
  display.print("H:");
  display.print(hunger);
  display.print(" P:");
  display.print(happiness);
  display.print(" E:");
  display.println(energy);
  // centered sprite area below stats
  const SpriteRow* sprite = spriteFromMood(mood);
  int sx = (SCREEN_WIDTH - SPRITE_W) / 2;
  int sy = 12; // leaves space for top text
  drawFrameGrid(sx, sy, sprite);
  display.display();
}

void handlePing() {
  server.send(200, "text/plain", "ok");
}


// Paste your 128-byte arrays here (from Python frames bytes):
const uint8_t FRAME_HAPPY[39][33] PROGMEM = { 
    {0,0,0,0,0,0,0,0,0,0,0,0,0,0,0,0,0,0,0,0,0,0,0,0,0,0,0,1,0,0,0,0,0},
    {0,0,0,0,0,0,1,0,0,0,0,0,0,0,0,0,0,0,0,0,0,0,0,0,0,0,1,1,0,0,0,0,0},
    {0,0,0,0,0,0,1,1,0,0,0,0,0,0,0,0,0,0,0,0,0,0,0,0,0,1,1,1,0,0,0,0,0},
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    {0,0,0,0,0,0,0,0,0,0,0,0,0,1,1,1,1,1,1,1,1,1,0,0,0,0,0,0,0,0,0,0,0}};
const uint8_t FRAME_SAD[39][33] PROGMEM = {
    {0,0,0,0,0,0,0,0,0,0,0,0,0,0,0,0,0,0,0,0,0,0,0,0,0,0,0,1,0,0,0,0,0},
    {0,0,0,0,0,0,1,0,0,0,0,0,0,0,0,0,0,0,0,0,0,0,0,0,0,0,1,1,0,0,0,0,0},
    {0,0,0,0,0,0,1,1,0,0,0,0,0,0,0,0,0,0,0,0,0,0,0,0,0,1,1,1,0,0,0,0,0},
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    {0,0,0,0,0,0,0,0,0,0,0,0,0,1,1,1,1,1,1,1,1,1,0,0,0,0,0,0,0,0,0,0,0}};
const uint8_t FRAME_CRYING[39][33] PROGMEM = {
    {0,0,0,0,0,0,0,0,0,0,0,0,0,0,0,0,0,0,0,0,0,0,0,0,0,0,0,1,0,0,0,0,0},
    {0,0,0,0,0,0,1,0,0,0,0,0,0,0,0,0,0,0,0,0,0,0,0,0,0,0,1,1,0,0,0,0,0},
    {0,0,0,0,0,0,1,1,0,0,0,0,0,0,0,0,0,0,0,0,0,0,0,0,0,1,1,1,0,0,0,0,0},
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    {0,0,0,0,0,0,0,0,0,0,0,0,0,1,1,1,1,1,1,1,1,1,0,0,0,0,0,0,0,0,0,0,0}};
const uint8_t FRAME_DEPRESSED[39][33] PROGMEM = {
    {0,0,0,0,0,0,0,0,0,0,0,0,0,0,0,0,0,0,0,0,0,0,0,0,0,0,0,1,0,0,0,0,0},
    {0,0,0,0,0,0,1,0,0,0,0,0,0,0,0,0,0,0,0,0,0,0,0,0,0,0,1,1,0,0,0,0,0},
    {0,0,0,0,0,0,1,1,0,0,0,0,0,0,0,0,0,0,0,0,0,0,0,0,0,1,1,1,0,0,0,0,0},
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    {0,0,0,0,0,0,0,0,0,0,0,0,0,1,1,1,1,1,1,1,1,1,0,0,0,0,0,0,0,0,0,0,0}};


const SpriteRow* spriteFromMood(const String& m) {
  if (m == "happy") return FRAME_HAPPY;
  if (m == "sad") return FRAME_SAD;
  if (m == "crying") return FRAME_CRYING;
  if (m == "depressed") return FRAME_DEPRESSED;
  return FRAME_SAD;
}
void drawFrameGrid(int x0, int y0, const SpriteRow* frame) {
  for (int y = 0; y < SPRITE_H; y++) {
    for (int x = 0; x < SPRITE_W; x++) {
      if (pgm_read_byte(&frame[y][x])) {
        display.drawPixel(x0 + x, y0 + y, SSD1306_WHITE);
      }
    }
  }
}

void setup() {
  Serial.begin(115200);
  delay(300);
  Wire.begin(8, 9); // SDA, SCL for many ESP32-C3 SuperMini boards
  if (!display.begin(SSD1306_SWITCHCAPVCC, 0x3C)) {
    Serial.println("SSD1306 not found");
  }
  display.clearDisplay();
  display.setTextColor(SSD1306_WHITE);
  display.setTextSize(1);
  display.setCursor(0, 0);
  display.println("Booting...");
  display.display();
  WiFi.mode(WIFI_STA);
  WiFi.begin(ssid, pass);
  Serial.printf("Connecting to: %s\n", ssid);
  int tries = 0;
  while (WiFi.status() != WL_CONNECTED && tries < 60) {
    delay(500);
    Serial.print(".");
    tries++;
  }
  Serial.println();
  if (WiFi.status() == WL_CONNECTED) {
    Serial.println("WiFi connected");
    Serial.print("ESP IP: ");
    Serial.println(WiFi.localIP());
    server.on("/ping", HTTP_GET, handlePing);
    server.on("/set", HTTP_GET, handleArgs);  // <-- important
    server.begin();
    Serial.println("HTTP server started");
  } else {
    Serial.print("WiFi failed, status=");
    Serial.println((int)WiFi.status());
  }
}

void loop() {
  server.handleClient();
}